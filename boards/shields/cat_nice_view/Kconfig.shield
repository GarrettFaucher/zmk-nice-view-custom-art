## boards/shields/cat_nice_view/Kconfig.shield
```kconfig
# Copyright (c) 2022 The ZMK Contributors
# SPDX-License-Identifier: MIT

config SHIELD_CAT_NICE_VIEW
    def_bool $(shields_list_contains,cat_nice_view)
```
